## boards/shields/mkd/Kconfig.defconfig
```kconfig
# Copyright (c) 2020 The ZMK Contributors
# SPDX-License-Identifier: MIT

if SHIELD_MKD

config ZMK_KEYBOARD_NAME
    default "mkd"

endif
```

## boards/shields/mkd/Kconfig.shield
```kconfig
# Copyright (c) 2020 The ZMK Contributors
# SPDX-License-Identifier: MIT

config SHIELD_MKD
    def_bool $(shields_list_contains,mkd)
```
